## board/bss/imx8mp_pdm600/Kconfig
```kconfig
if TARGET_BSS_IMX8MP_PDM600

config SYS_BOARD
	default "imx8mp_pdm600"

config SYS_VENDOR
	default "bss"

config SYS_CONFIG_NAME
	default "imx8mp_pdm600"

config IMX_CONFIG
	default "board/phytec/phycore_imx8mp/imximage-8mp-sd.cfg"

source "board/phytec/common/Kconfig"

endif
```
